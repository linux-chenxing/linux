// SPDX-License-Identifier: GPL-2.0-or-later
/*
 * Copyright (c) 2021 thingy.jp.
 * Author: Daniel Palmer <daniel@thingy.jp>
 */

/dts-v1/;
#include "mstar-infinity2m-ssd202d-100ask-dongshanpione.dts"

#include <dt-bindings/gpio/gpio.h>

/ {
	model = "DongShanPi One + Carrier";
};

&emac {
	pinctrl-names = "default";
	pinctrl-0 = <&emac_mode1_pins>, <&pm_led_mode1_pins>;
	status = "okay";
};

&bach {
	status = "okay";
};
