// SPDX-License-Identifier: GPL-2.0-or-later
/*
 * Copyright (c) 2021 thingy.jp.
 * Author: Daniel Palmer <daniel@thingy.jp>
 */

#include <dt-bindings/gpio/mstar.h>
#include <dt-bindings/pinctrl/mstar.h>

#include "mstar-pioneer3.dtsi"

/ {
	memory@20000000 {
		device_type = "memory";
		reg = <0x20000000 0x4000000>;
	};
};

&gpio_pm {
	compatible = "sstar,ssd212-gpio-pm";
	interrupts-extended = <&intc_fiq GIC_SPI 23 IRQ_TYPE_LEVEL_HIGH>;
	status = "okay";
};

&pinctrl_pm {
	compatible = "sstar,ssd212-pm-pinctrl";
};
