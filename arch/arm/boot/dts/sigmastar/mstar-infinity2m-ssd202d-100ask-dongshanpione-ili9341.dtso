// SPDX-License-Identifier: GPL-2.0-or-later
/*
 * Copyright (c) 2022 thingy.jp.
 * Author: Daniel Palmer <daniel@thingy.jp>
 */

/dts-v1/;
/plugin/;

#include <dt-bindings/gpio/gpio.h>
#include <dt-bindings/gpio/msc313-gpio.h>

&mspi0 {
	pinctrl-names = "default";
	pinctrl-0 = <&spi0_mode5_pins>;
	status = "okay";
	display@0{
		compatible = "adafruit,yx240qv29", "ilitek,ili9341";
		reg = <0>;
		spi-max-frequency = <20000000>;
		dc-gpios = <&gpio SSD20XD_GPIO_UART0_TX GPIO_ACTIVE_HIGH>;
		reset-gpios = <&gpio SSD20XD_GPIO_UART0_RX GPIO_ACTIVE_HIGH>;
		vcc-supply = <&vcc_ext_3v3>;
		rotation = <90>;
	};
};
