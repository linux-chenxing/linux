// SPDX-License-Identifier: GPL-2.0-or-later
/*
 * Copyright (c) 2022 thingy.jp.
 * Author: Daniel Palmer <daniel@thingy.jp>
 */

/dts-v1/;
/plugin/;

#include <dt-bindings/gpio/gpio.h>
#include <dt-bindings/gpio/msc313-gpio.h>

&mspi0 {
	pinctrl-names = "default";
	pinctrl-0 = <&ssd210_spi0_mode3_pins>;
	status = "okay";
	display@0{
		compatible = "adafruit,yx240qv29", "ilitek,ili9341";
		reg = <0>;
		spi-max-frequency = <20000000>;
		dc-gpios = <&gpio 33 GPIO_ACTIVE_HIGH>;
		reset-gpios = <&gpio 34 GPIO_ACTIVE_HIGH>;
		vcc-supply = <&reg_vcc_io>;
		rotation = <90>;
	};
};
