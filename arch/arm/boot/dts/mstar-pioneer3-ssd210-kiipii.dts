// SPDX-License-Identifier: GPL-2.0
/*
 * Copyright (c) 2019 thingy.jp.
 * Author: Daniel Palmer <daniel@thingy.jp>
 */

/dts-v1/;
#include "mstar-pioneer3-ssd210.dtsi"

/ {
	model = "KiiPii";
	compatible = "thingyjp,kiipii", "sstar,pioneer3";

	aliases {
		serial0 = &pm_uart;
	};

	chosen {
		stdout-path = "serial0:115200n8";
		bootargs = "console=ttyS0,115200 clk_ignore_unused earlyprintk";
	};
};

&pm_uart {
	status = "okay";
};
