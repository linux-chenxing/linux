// SPDX-License-Identifier: GPL-2.0-or-later
/*
 * Copyright (c) 2020 thingy.jp.
 * Author: Daniel Palmer <daniel@thingy.jp>
 */

/dts-v1/;
#include "mstar-infinity2m-ssd201-wirelesstag-ido-som2d01.dtsi"

/ {
	model = "SOM2D01 (SSD201)";
	compatible = "ido,som2d01", "mstar,infinity2m";

	aliases {
		serial0 = &pm_uart;
	};

	chosen {
		stdout-path = "serial0:115200n8";
		bootargs = "console=ttyS0,115200 clk_ignore_unused earlyprintk";
	};

	vcc_dram: fixedregulator@1 {
		compatible = "regulator-fixed";
		regulator-name = "vcc_dram";
		regulator-min-microvolt = <1800000>;
		regulator-max-microvolt = <1800000>;
		regulator-boot-on;
	};
};

/*
&usbphy0 {
	status = "okay";
};

&uhc0 {
	status = "okay";
};

&usbphy2 {
	status = "okay";
};

&uhc2 {
	status = "okay";
};

&miu {
	ddr-supply = <&vcc_dram>;
};
*/
