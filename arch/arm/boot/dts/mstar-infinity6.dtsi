// SPDX-License-Identifier: GPL-2.0
/*
 * Copyright (c) 2020 thingy.jp.
 * Author: Daniel Palmer <daniel@thingy.jp>
 */

#include "mstar-infinity.dtsi"

/ {
};

&bdma {
	interrupts = <40 IRQ_TYPE_LEVEL_HIGH>,
		     <41 IRQ_TYPE_LEVEL_HIGH>,
		     <61 IRQ_TYPE_LEVEL_HIGH>,
		     <62 IRQ_TYPE_LEVEL_HIGH>;
};
