## arch/arm/configs/mstar_defconfig
```kconfig
# CONFIG_LOCALVERSION_AUTO is not set
CONFIG_KERNEL_XZ=y
CONFIG_POSIX_MQUEUE=y
CONFIG_GENERIC_IRQ_DEBUGFS=y
CONFIG_NO_HZ_IDLE=y
CONFIG_HIGH_RES_TIMERS=y
CONFIG_IKCONFIG=y
CONFIG_IKCONFIG_PROC=y
# CONFIG_UTS_NS is not set
# CONFIG_PID_NS is not set
CONFIG_SCHED_AUTOGROUP=y
CONFIG_BLK_DEV_INITRD=y
# CONFIG_RD_BZIP2 is not set
# CONFIG_RD_LZMA is not set
# CONFIG_RD_XZ is not set
# CONFIG_RD_LZO is not set
# CONFIG_RD_LZ4 is not set
# CONFIG_RD_ZSTD is not set
CONFIG_CC_OPTIMIZE_FOR_SIZE=y
# CONFIG_COMPAT_BRK is not set
# CONFIG_SLAB_MERGE_DEFAULT is not set
CONFIG_SMP=y
CONFIG_NR_CPUS=4
# CONFIG_SCHED_MC is not set
CONFIG_HZ_100=y
CONFIG_WQ_POWER_EFFICIENT_DEFAULT=y
CONFIG_CPU_FREQ=y
CONFIG_CPU_FREQ_DEFAULT_GOV_ONDEMAND=y
CONFIG_CPUFREQ_DT=y
CONFIG_CPU_IDLE_GOV_LADDER=y
# CONFIG_SECCOMP is not set
# CONFIG_STACKPROTECTOR is not set
CONFIG_COMPAT_32BIT_TIME=y
CONFIG_MODULES=y
# CONFIG_BLK_DEBUG_FS is not set
# CONFIG_MQ_IOSCHED_DEADLINE is not set
# CONFIG_MQ_IOSCHED_KYBER is not set
CONFIG_NET=y
CONFIG_PACKET=y
CONFIG_UNIX=y
CONFIG_INET=y
# CONFIG_IPV6_SIT is not set
CONFIG_CFG80211=y
CONFIG_MAC80211=y
# CONFIG_ETHTOOL_NETLINK is not set
CONFIG_UEVENT_HELPER=y
CONFIG_DEVTMPFS=y
CONFIG_DEVTMPFS_MOUNT=y
# CONFIG_STANDALONE is not set
# CONFIG_PREVENT_FIRMWARE_BUILD is not set
CONFIG_SIMPLE_PM_BUS=y
CONFIG_MTD=y
CONFIG_MTD_BLOCK=y
CONFIG_MTD_PARTITIONED_MASTER=y
CONFIG_MTD_SPI_NAND=y
CONFIG_MTD_SPI_NOR=y
CONFIG_MTD_UBI=y
CONFIG_MTD_UBI_BLOCK=y
CONFIG_OF=y
CONFIG_DUMMY_IRQ=y
CONFIG_SRAM=y
CONFIG_SCSI=y
# CONFIG_SCSI_PROC_FS is not set
CONFIG_BLK_DEV_SD=y
# CONFIG_SCSI_LOWLEVEL is not set
CONFIG_NETDEVICES=y
# CONFIG_NET_CORE is not set
# CONFIG_NET_VENDOR_ALACRITECH is not set
# CONFIG_NET_VENDOR_AMAZON is not set
# CONFIG_NET_VENDOR_AQUANTIA is not set
# CONFIG_NET_VENDOR_ARC is not set
# CONFIG_NET_VENDOR_BROADCOM is not set
CONFIG_MACB=y
# CONFIG_NET_VENDOR_CAVIUM is not set
# CONFIG_NET_VENDOR_CORTINA is not set
# CONFIG_NET_VENDOR_EZCHIP is not set
# CONFIG_NET_VENDOR_GOOGLE is not set
# CONFIG_NET_VENDOR_HUAWEI is not set
# CONFIG_NET_VENDOR_INTEL is not set
# CONFIG_NET_VENDOR_MICROSOFT is not set
# CONFIG_NET_VENDOR_MARVELL is not set
# CONFIG_NET_VENDOR_MELLANOX is not set
# CONFIG_NET_VENDOR_MICREL is not set
# CONFIG_NET_VENDOR_MICROCHIP is not set
# CONFIG_NET_VENDOR_MICROSEMI is not set
# CONFIG_NET_VENDOR_NATSEMI is not set
# CONFIG_NET_VENDOR_NETRONOME is not set
# CONFIG_NET_VENDOR_NI is not set
# CONFIG_NET_VENDOR_PENSANDO is not set
# CONFIG_NET_VENDOR_QUALCOMM is not set
# CONFIG_NET_VENDOR_RENESAS is not set
# CONFIG_NET_VENDOR_ROCKER is not set
# CONFIG_NET_VENDOR_SAMSUNG is not set
# CONFIG_NET_VENDOR_SEEQ is not set
# CONFIG_NET_VENDOR_SOLARFLARE is not set
# CONFIG_NET_VENDOR_SOCIONEXT is not set
# CONFIG_NET_VENDOR_STMICRO is not set
# CONFIG_NET_VENDOR_SYNOPSYS is not set
# CONFIG_NET_VENDOR_VIA is not set
# CONFIG_NET_VENDOR_WIZNET is not set
# CONFIG_NET_VENDOR_XILINX is not set
CONFIG_MSC313_PHY=y
CONFIG_USB_USBNET=y
# CONFIG_USB_NET_CDC_NCM is not set
# CONFIG_USB_NET_NET1080 is not set
CONFIG_USB_NET_RNDIS_HOST=y
# CONFIG_USB_NET_CDC_SUBSET is not set
# CONFIG_USB_NET_ZAURUS is not set
# CONFIG_WLAN_VENDOR_ADMTEK is not set
# CONFIG_WLAN_VENDOR_ATH is not set
# CONFIG_WLAN_VENDOR_ATMEL is not set
# CONFIG_WLAN_VENDOR_BROADCOM is not set
# CONFIG_WLAN_VENDOR_CISCO is not set
# CONFIG_WLAN_VENDOR_INTEL is not set
# CONFIG_WLAN_VENDOR_INTERSIL is not set
# CONFIG_WLAN_VENDOR_MARVELL is not set
# CONFIG_WLAN_VENDOR_MEDIATEK is not set
# CONFIG_WLAN_VENDOR_MICROCHIP is not set
# CONFIG_WLAN_VENDOR_RALINK is not set
CONFIG_RTL8192CU=y
# CONFIG_WLAN_VENDOR_RSI is not set
# CONFIG_WLAN_VENDOR_ST is not set
# CONFIG_WLAN_VENDOR_TI is not set
# CONFIG_WLAN_VENDOR_ZYDAS is not set
# CONFIG_WLAN_VENDOR_QUANTENNA is not set
# CONFIG_KEYBOARD_ATKBD is not set
CONFIG_KEYBOARD_GPIO=y
CONFIG_KEYBOARD_GPIO_POLLED=y
# CONFIG_INPUT_MOUSE is not set
CONFIG_INPUT_TOUCHSCREEN=y
CONFIG_TOUCHSCREEN_GOODIX=y
# CONFIG_SERIO is not set
# CONFIG_LEGACY_PTYS is not set
CONFIG_SERIAL_8250=y
# CONFIG_SERIAL_8250_DEPRECATED_OPTIONS is not set
CONFIG_SERIAL_8250_CONSOLE=y
CONFIG_SERIAL_8250_NR_UARTS=8
CONFIG_SERIAL_8250_RUNTIME_UARTS=8
CONFIG_SERIAL_8250_DW=y
CONFIG_SERIAL_OF_PLATFORM=y
CONFIG_HW_RANDOM=y
CONFIG_DEVKMEM=y
# CONFIG_I2C_COMPAT is not set
CONFIG_I2C_CHARDEV=y
CONFIG_SPI=y
CONFIG_SPI_SPIDEV=y
CONFIG_PINCTRL=y
CONFIG_GPIOLIB=y
CONFIG_GPIO_IP6XXX=y
CONFIG_W1=y
CONFIG_W1_MASTER_GPIO=y
CONFIG_W1_SLAVE_THERM=y
CONFIG_POWER_RESET=y
CONFIG_POWER_RESET_SYSCON=y
CONFIG_SENSORS_IIO_HWMON=y
CONFIG_SENSORS_SHT15=y
CONFIG_SENSORS_SHT21=y
CONFIG_SENSORS_SHT3x=y
CONFIG_SENSORS_SHTC1=y
CONFIG_WATCHDOG=y
CONFIG_MFD_AXP20X_I2C=y
CONFIG_MFD_IP6XXX=y
CONFIG_REGULATOR=y
CONFIG_REGULATOR_DEBUG=y
CONFIG_REGULATOR_FIXED_VOLTAGE=y
CONFIG_REGULATOR_AXP20X=y
CONFIG_RC_CORE=y
# CONFIG_RC_MAP is not set
CONFIG_LIRC=y
CONFIG_RC_DEVICES=y
CONFIG_IR_GPIO_CIR=y
CONFIG_IR_GPIO_TX=y
# CONFIG_MEDIA_CEC_SUPPORT is not set
CONFIG_MEDIA_SUPPORT=y
# CONFIG_MEDIA_SUPPORT_FILTER is not set
CONFIG_MEDIA_SUBDRV_AUTOSELECT=y
CONFIG_VIDEO_V4L2_SUBDEV_API=y
# CONFIG_DVB_NET is not set
# CONFIG_RADIO_ADAPTERS is not set
CONFIG_V4L_PLATFORM_DRIVERS=y
CONFIG_DRM=y
CONFIG_FB_SSD1307=y
CONFIG_BACKLIGHT_PWM=y
CONFIG_BACKLIGHT_GPIO=y
CONFIG_LOGO=y
CONFIG_SOUND=y
CONFIG_SND=y
CONFIG_SND_OSSEMUL=y
CONFIG_SND_MIXER_OSS=y
CONFIG_SND_PCM_OSS=y
# CONFIG_SND_SUPPORT_OLD_API is not set
# CONFIG_SND_DRIVERS is not set
CONFIG_SND_HDA_PREALLOC_SIZE=64
# CONFIG_SND_SPI is not set
CONFIG_SND_USB_AUDIO=y
CONFIG_SND_SOC=y
# CONFIG_HID is not set
# CONFIG_USB_HID is not set
CONFIG_USB=y
CONFIG_USB_OTG=y
CONFIG_USB_FOTG210_HCD=y
CONFIG_USB_ACM=y
CONFIG_USB_WDM=y
CONFIG_USB_STORAGE=y
CONFIG_USB_MUSB_HDRC=y
CONFIG_USB_MUSB_GADGET=y
CONFIG_USB_MUSB_MSTAR=y
CONFIG_MUSB_PIO_ONLY=y
CONFIG_USB_SERIAL=y
CONFIG_USB_SERIAL_CP210X=y
CONFIG_USB_SERIAL_OPTION=y
CONFIG_NOP_USB_XCEIV=y
CONFIG_USB_GADGET=y
CONFIG_USB_GADGET_DEBUG=y
CONFIG_MMC=y
CONFIG_MMC_TEST=y
CONFIG_MMC_DEBUG=y
CONFIG_NEW_LEDS=y
CONFIG_LEDS_CLASS=y
CONFIG_LEDS_GPIO=y
CONFIG_LEDS_PWM=y
CONFIG_LEDS_TRIGGERS=y
CONFIG_LEDS_TRIGGER_HEARTBEAT=y
CONFIG_LEDS_TRIGGER_ACTIVITY=y
CONFIG_LEDS_TRIGGER_GPIO=y
CONFIG_LEDS_TRIGGER_DEFAULT_ON=y
CONFIG_LEDS_TRIGGER_NETDEV=y
CONFIG_RTC_CLASS=y
CONFIG_RTC_DEBUG=y
CONFIG_RTC_DRV_DS1307=y
CONFIG_RTC_DRV_DS1307_CENTURY=y
CONFIG_RTC_DRV_IP6XXX=y
CONFIG_RTC_DRV_ISL1208=y
# CONFIG_RTC_DRV_CMOS is not set
CONFIG_DMADEVICES=y
CONFIG_DMADEVICES_DEBUG=y
CONFIG_DMADEVICES_VDEBUG=y
CONFIG_DMATEST=y
# CONFIG_VIRTIO_MENU is not set
# CONFIG_VHOST_MENU is not set
CONFIG_STAGING=y
CONFIG_FB_TFT=y
CONFIG_FB_TFT_ILI9340=y
CONFIG_FB_TFT_ILI9341=y
CONFIG_COMMON_CLK=y
CONFIG_MSC313E_TIMER=y
# CONFIG_IOMMU_SUPPORT is not set
CONFIG_REMOTEPROC=y
CONFIG_REMOTEPROC_CDEV=y
CONFIG_MEMORY=y
CONFIG_IIO=y
CONFIG_IIO_ST_ACCEL_3AXIS=y
CONFIG_MMA7660=y
CONFIG_INV_MPU6050_I2C=y
CONFIG_SENSORS_TSL2563=y
CONFIG_IIO_SYSFS_TRIGGER=y
CONFIG_RESET_CONTROLLER=y
CONFIG_GENERIC_PHY=y
# CONFIG_NVMEM_SYSFS is not set
CONFIG_FPGA=y
CONFIG_FPGA_MGR_ICE40_SPI=y
CONFIG_EXT4_FS=y
# CONFIG_DNOTIFY is not set
# CONFIG_INOTIFY_USER is not set
CONFIG_VFAT_FS=y
CONFIG_TMPFS=y
CONFIG_CONFIGFS_FS=y
CONFIG_JFFS2_FS=y
CONFIG_SQUASHFS=y
CONFIG_SQUASHFS_LZ4=y
CONFIG_SQUASHFS_LZO=y
CONFIG_SQUASHFS_XZ=y
CONFIG_SQUASHFS_ZSTD=y
CONFIG_NFS_FS=y
# CONFIG_NFS_V2 is not set
# CONFIG_NFS_DISABLE_UDP_SUPPORT is not set
CONFIG_NLS_CODEPAGE_437=y
CONFIG_NLS_ISO8859_1=y
CONFIG_LSM="yama,loadpin,safesetid,integrity"
CONFIG_CRYPTO_CRYPTD=y
CONFIG_CRYPTO_SEQIV=y
CONFIG_CRYPTO_SHA1=y
CONFIG_CRYPTO_CHACHA20=y
CONFIG_PRINTK_TIME=y
CONFIG_DYNAMIC_DEBUG=y
# CONFIG_SYMBOLIC_ERRNAME is not set
CONFIG_DEBUG_INFO=y
CONFIG_FRAME_WARN=1024
# CONFIG_SECTION_MISMATCH_WARN_ONLY is not set
CONFIG_DEBUG_FS=y
CONFIG_DEBUG_KERNEL=y
# CONFIG_DEBUG_MISC is not set
CONFIG_PANIC_TIMEOUT=10
# CONFIG_SCHED_DEBUG is not set
# CONFIG_RCU_TRACE is not set
# CONFIG_FTRACE is not set
# CONFIG_STRICT_DEVMEM is not set
# CONFIG_RUNTIME_TESTING_MENU is not set
```

## arch/mips/mstar/Kconfig
```kconfig
# SPDX-License-Identifier: GPL-2.0
if MSTAR_MIPS

config MACH_KROUNS
	bool "MStar Kronus family support"
	help
	  Support for the Kronus SoC family, which consists of at least:
	    - MSD7816
	    - MSD7818

config MACH_TITANIA4
	bool "MStar Titania4 family support"
	help
	  Support for the Titania4 SoC family, which consists of at least:
	    - MSD306PT
	    - MSD309PX

choice
	prompt "Device tree selection"
	default DTB_MST_NONE
	help
	  Select the device tree that will be built into kernel

	config DTB_MST_NONE
		bool "None"

	config DTB_MST_MSD7816_TEST
		bool "MSD7816 test"
		depends on MACH_KROUNS
		select BUILTIN_DTB

	config DTB_MST_MSD309PX_TEST
		bool "MSD309PX test"
		depends on MACH_TITANIA4
		select BUILTIN_DTB
endchoice

endif
```

## drivers/clk/mstar/Kconfig
```kconfig
# SPDX-License-Identifier: GPL-2.0-only
config MSTAR_MSC313_MPLL
	bool "MStar MPLL driver"
	depends on ARCH_MSTARV7 || COMPILE_TEST
	default ARCH_MSTARV7
	select REGMAP_MMIO
	help
	  Support for the MPLL PLL and dividers block present on
	  MStar/Sigmastar SoCs.

config MSTAR_MSC313_CPUPLL
	bool "MStar CPUPLL driver"
	depends on ARCH_MSTARV7 || COMPILE_TEST
	default ARCH_MSTARV7
	help
	  Support for the CPU PLL present on MStar/Sigmastar SoCs.

config MSTAR_MSC313_UPLL
	bool "MStar UPLL driver"
	depends on ARCH_MSTARV7 || COMPILE_TEST
	default ARCH_MSTARV7
	help
	  Support for the USB PLL present on MStar/Sigmastar SoCs.

config MSTAR_MSC313_LPLL
	bool "MStar LPLL driver"
	depends on ARCH_MSTARV7 || COMPILE_TEST
	default ARCH_MSTARV7
	help
	  Support for the Line PLL present on MStar/Sigmastar SoCs.

config MSTAR_MSC313_MIUPLL
	bool "MStar MIUPLL driver"
	depends on ARCH_MSTARV7 || COMPILE_TEST
	default ARCH_MSTARV7
	help
	  Support for the MIU PLL present on MStar/Sigmastar SoCs.

config MSTAR_MSC313_PM_MUXES
	bool "MStar PM region muxes driver"
	depends on ARCH_MSTARV7 || COMPILE_TEST
	default ARCH_MSTARV7
	help
	  Support for the muxes embedded in the pm region.

config MSTAR_MSC313_SC_GP_CTRL_MUXES
	bool "MStar SC GP CTRL muxes driver"
	depends on ARCH_MSTARV7 || COMPILE_TEST
	default ARCH_MSTARV7
	help
	  Support for the muxes embedded in the sc-gp-ctrl registers.
```

## drivers/crypto/mstar/Kconfig
```kconfig
# SPDX-License-Identifier: GPL-2.0-only
config CRYPTO_DEV_MSC313_SHA
	tristate "Support for MSC313 SHA unit"
	depends on ARCH_MSTARV7
	select CRYPTO_SHA256
	select CRYPTO_ENGINE

config CRYPTO_DEV_MSC313_AESDMA
	tristate "Support for MSC313 AESDMA unit"
	depends on ARCH_MSTARV7
	depends on HAS_DMA
```

## drivers/dma/mstar/Kconfig
```kconfig
# SPDX-License-Identifier: GPL-2.0-only

config MSTAR_MSC313_BDMA
	tristate "MStar MSC313 BDMA support"
	depends on ARCH_MSTARV7 || COMPILE_TEST
	select DMA_ENGINE

config MSTAR_MSC313_CMDQ
	tristate "MStar MSC313 CMDQ support"
	depends on ARCH_MSTARV7 || COMPILE_TEST
	select DMA_ENGINE

config MSTAR_MSC313_URDMA
	tristate "MStar MSC313 URDMA support"
	depends on ARCH_MSTARV7 || COMPILE_TEST
	select DMA_ENGINE

config SSTAR_SSD20XD_MOVEDMA
	tristate "SigmaStar SSD20xD MOVEDMA support"
	depends on ARCH_MSTARV7 || COMPILE_TEST
	select DMA_ENGINE
```

## drivers/gpu/drm/mstar/Kconfig
```kconfig
# SPDX-License-Identifier: GPL-2.0-only
config DRM_MSTAR
	tristate "DRM Support for MStar"
	depends on DRM && (ARM || ARM64) && COMMON_CLK
	depends on ARCH_MSTAR || COMPILE_TEST
	select DRM_GEM_CMA_HELPER
	select DRM_KMS_HELPER
	select DRM_KMS_CMA_HELPER
	select DRM_PANEL
	select REGMAP_MMIO
	select VIDEOMODE_HELPERS
	help
	  MStar DRM
```

## drivers/media/platform/mstar/Kconfig
```kconfig
config VIDEO_MSTAR_VIF
	tristate "MStar VIF"
	depends on VIDEO_V4L2 && COMMON_CLK && VIDEO_V4L2_SUBDEV_API && HAS_DMA
	depends on ARCH_MSTAR || COMPILE_TEST
	select VIDEOBUF2_DMA_CONTIG
	select V4L2_FWNODE
	help
	  xx
```

## drivers/phy/mstar/Kconfig
```kconfig
# SPDX-License-Identifier: GPL-2.0-only
#
# Phy drivers for MStar/SigmaStar devices
#

config PHY_MSC313_USB
	tristate "MSC313 USB PHY driver"
	select GENERIC_PHY
	depends on ARCH_MSTARV7 || COMPILE_TEST
	depends on OF
	depends on HAS_IOMEM
	default ARCH_MSTARV7
	help
	  Enable this to support the USB PHY in MStar/SigmaStar SoCs

config PHY_SSD20XD_DPHY
	tristate "SSD20XD MIPI D-PHY driver"
	select GENERIC_PHY
	depends on ARCH_MSTARV7 || COMPILE_TEST
	depends on OF
	depends on HAS_IOMEM
	default ARCH_MSTARV7
	help
	  Enable this to support the MIPI D-PHY in MStar/SigmaStar SoCs
```

## drivers/pinctrl/mstar/Kconfig
```kconfig
config PINCTRL_MSTAR
	bool
	select GENERIC_PINMUX_FUNCTIONS
	select GENERIC_PINCTRL_GROUPS
	select GENERIC_PINCONF
```

## drivers/soc/mstar/Kconfig
```kconfig
# SPDX-License-Identifier: GPL-2.0-only

config MSTAR_MSC313_CMDQ
	tristate "MStar MSC313 CMDQ support"
	depends on ARCH_MSTARV7 || COMPILE_TEST
```

## sound/soc/mstar/Kconfig
```kconfig
# SPDX-License-Identifier: GPL-2.0-only
menu "ASoC support for MStar platforms"
	depends on ARCH_MSTARV7 || COMPILE_TEST

config SND_MSTAR_INFINITY
	tristate "Audio support for iNfinity"
	depends on MACH_INFINITY

endmenu
```
