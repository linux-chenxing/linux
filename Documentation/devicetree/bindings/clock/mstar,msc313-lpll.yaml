## Documentation/devicetree/bindings/clock/mstar,msc313-lpll.yaml
```yaml
# SPDX-License-Identifier: (GPL-2.0 OR BSD-2-Clause)
%YAML 1.2
---
$id: http://devicetree.org/schemas/clock/mstar,msc313-lpll.yaml#
$schema: http://devicetree.org/meta-schemas/core.yaml#

title: MStar/Sigmastar MSC313 LPLL

maintainers:
  - Daniel Palmer <daniel@thingy.jp>

description: |
  The MStar/SigmaStar MSC313 and later ARMv7 chips have an LPLL block.

properties:
  compatible:
    const: mstar,msc313-lpll

  "#clock-cells":
    const: 1

  clocks:
    maxItems: 1

  reg:
    maxItems: 1

required:
  - compatible
  - "#clock-cells"
  - clocks
  - reg

additionalProperties: false

examples:
  - |
    lpll@206000 {
        compatible = "mstar,msc313-lpll";
        reg = <0x206000 0x200>;
        #clock-cells = <1>;
        clocks = <&xtal>;
    };
```

## Documentation/devicetree/bindings/clock/mstar,msc313-usbpll.yaml
```yaml
# SPDX-License-Identifier: (GPL-2.0 OR BSD-2-Clause)
%YAML 1.2
---
$id: http://devicetree.org/schemas/clock/mstar,msc313-usbpll.yaml#
$schema: http://devicetree.org/meta-schemas/core.yaml#

title: MStar/Sigmastar MSC313 USB PLL

maintainers:
  - Daniel Palmer <daniel@thingy.jp>

description: |
  The MStar/SigmaStar MSC313 and later ARMv7 chips have one or
  more USB PLLs that generate the clocks for USB.

properties:
  compatible:
    const: mstar,msc313-usbpll

  "#clock-cells":
    const: 1

  clocks:
    maxItems: 1

  reg:
    maxItems: 1

required:
  - compatible
  - "#clock-cells"
  - clocks
  - reg

additionalProperties: false

examples:
  - |
    mpll@206000 {
        compatible = "mstar,msc313-usbpll";
        reg = <0x206000 0x200>;
        #clock-cells = <1>;
        clocks = <&xtal>;
    };
```

## Documentation/devicetree/bindings/crypto/msc313,msc313-aesdma.yaml
```yaml
# SPDX-License-Identifier: (GPL-2.0-only OR BSD-2-Clause)
%YAML 1.2
---
$id: http://devicetree.org/schemas/crypto/msc313,msc313-aesdma.yaml#
$schema: http://devicetree.org/meta-schemas/core.yaml#

title: MStar/SigmaStar AESDMA bindings

maintainers:
  - Daniel Palmer <daniel@thingy.jp>

properties:
  compatible:
    enum:
      - msc313,msc313-aesdma
      - sstar,ssd20xd-aesdma

  reg:
    maxItems: 1

  clocks:
    maxItems: 1

required:
  - compatible
  - reg
  - clocks

additionalProperties: false

examples:
  - |
    #include <dt-bindings/clock/mstar-msc313-clkgen.h>
    aesdma@224540 {
      reg = <0x224540 0xc0>;
      compatible = "mstar,msc313-aesdma";
      clocks = <&clkgen MSC313_CLKGEN_DEGLITCHES MSC313_CLKGEN_AESDMA 0>;
    };
...
```

## Documentation/devicetree/bindings/crypto/msc313,msc313-sha.yaml
```yaml
# SPDX-License-Identifier: (GPL-2.0-only OR BSD-2-Clause)
%YAML 1.2
---
$id: http://devicetree.org/schemas/crypto/msc313,msc313-sha.yaml#
$schema: http://devicetree.org/meta-schemas/core.yaml#

title: MStar/SigmaStar SHA bindings

maintainers:
  - Daniel Palmer <daniel@thingy.jp>

properties:
  compatible:
    enum:
      - msc313,msc313-sha

  reg:
    maxItems: 1

  clocks:
    maxItems: 1

required:
  - compatible
  - reg
  - clocks

additionalProperties: false

examples:
  - |
    #include <dt-bindings/clock/mstar-msc313-clkgen.h>
    sha@224420 {
      reg = <0x224420 0x60>;
      compatible = "mstar,msc313-sha";
      clocks = <&clkgen MSC313_CLKGEN_DEGLITCHES MSC313_CLKGEN_AESDMA 0>;
    };
...
```

## Documentation/devicetree/bindings/dma/mstar,msc313-bdma.yaml
```yaml
# SPDX-License-Identifier: (GPL-2.0-only OR BSD-2-Clause)
%YAML 1.2
---
$id: http://devicetree.org/schemas/dma/mstar,msc313-bdma.yaml#
$schema: http://devicetree.org/meta-schemas/core.yaml#

title: MStar/SigmaStar BDMA

description: |
  MStar/SigmaStar ARMv7 SoCs contain a DMA controller called
  BDMA. This seems to be the generic DMA controller for the
  system and seems to be capable of doing mem to/from device
  for most of the other IP blocks and mem to mem transfers.

maintainers:
  - Daniel Palmer <daniel@thingy.jp>

allOf:
  - $ref: "dma-controller.yaml#"

properties:
  "#dma-cells":
    const: 1

  compatible:
    enum:
      - mstar,msc313-bdma
      - sstar,ssd20xd-bdma
      - sstar,ssd210-bdma

  reg:
    maxItems: 1

  clocks:
    maxItems: 1

  interrupts:
    description: |
      For most BDMA versions there is one IRQ per DMA
      channel, so for 2 channel versions (msc313-bdma) you
      need 2 IRQs and for 4 channel versions (ssd20xd-bdma)
      you need 4. Some versions (ssd210-bdma) combine all
      channel interrupts into a single IRQ. For these single
      IRQ versions you should supply 1 IRQ. 
    maxItems: 4

required:
  - compatible
  - reg
  - clocks
  - interrupts

examples:
  - |
    #include <dt-bindings/interrupt-controller/irq.h>
    #include <dt-bindings/interrupt-controller/arm-gic.h>
    #include <dt-bindings/clock/mstar-msc313-clkgen.h>
    dma-controller@200400 {
      compatible = "mstar,msc313-bdma";
      reg = <0x200400 0x80>;
      interrupt-parent = <&intc_irq>;
      interrupts = <GIC_SPI 40 IRQ_TYPE_LEVEL_HIGH>,
                   <GIC_SPI 41 IRQ_TYPE_LEVEL_HIGH>;
      clocks = <&clkgen MSC313_CLKGEN_DEGLITCHES MSC313_CLKGEN_BDMA 0>;
      #dma-cells = <1>;
    };

...
```

## Documentation/devicetree/bindings/gpio/mstar,msc313-gpio-pm.yaml
```yaml
# SPDX-License-Identifier: GPL-2.0-only OR BSD-2-Clause
%YAML 1.2
---
$id: http://devicetree.org/schemas/gpio/mstar,msc313-gpio-pm.yaml#
$schema: http://devicetree.org/meta-schemas/core.yaml#

title: MStar/SigmaStar GPIO controller

maintainers:
  - Daniel Palmer <daniel@thingy.jp>

properties:
  $nodename:
    pattern: "^gpio@[0-9a-f]+$"

  compatible:
    enum:
      - mstar,msc313-gpio-pm
      - sstar,ssd20xd-gpio-pm
      - sstar,ssd212-gpio-pm
      - mstar,ssc8336-gpio-pm

  reg:
    maxItems: 1

  gpio-controller: true

  "#gpio-cells":
    const: 2

  gpio-ranges: true

  interrupt-controller: true

  "#interrupt-cells":
    const: 2

required:
  - compatible
  - reg
  - gpio-controller
  - "#gpio-cells"
  - interrupt-controller
  - "#interrupt-cells"

additionalProperties: false

examples:
  - |
    #include <dt-bindings/gpio/msc313-gpio-pm.h>

    gpio@1e00 {
      compatible = "mstar,msc313-gpio-pm";
      #gpio-cells = <2>;
      reg = <0x1e00 0x200>;
      gpio-controller;
      #interrupt-cells = <2>;
      interrupt-controller;
    };
```

## Documentation/devicetree/bindings/interrupt-controller/mstar,msc313-pm-wakeup-intc.yaml
```yaml
# SPDX-License-Identifier: (GPL-2.0 OR BSD-2-Clause)
# Copyright 2020 thingy.jp.
%YAML 1.2
---
$id: "http://devicetree.org/schemas/interrupt-controller/mstar,msc313-pm-wakeup-intc#"
$schema: "http://devicetree.org/meta-schemas/core.yaml#"

title: MStar/SigmaStar ARMv7 SoC Wakeup Interrupt Controller Device Tree Bindings

maintainers:
  - Daniel Palmer <daniel@thingy.jp>

allOf:
  - $ref: /schemas/interrupt-controller.yaml#

properties:
  "#interrupt-cells":
    const: 1

  compatible:
    enum:
      - mstar,msc313-pm-wakeup-intc

  reg:
    maxItems: 1

  interrupt-controller: true

required:
  - "#interrupt-cells"
  - compatible
  - reg
  - interrupt-controller

additionalProperties: false

...
```

## Documentation/devicetree/bindings/pinctrl/mstar,msc313-pm-pinctrl.yaml
```yaml
# SPDX-License-Identifier: GPL-2.0-only OR BSD-2-Clause
%YAML 1.2
---
$id: http://devicetree.org/schemas/pinctrl/mstar,msc313-pm-pinctrl.yaml#
$schema: http://devicetree.org/meta-schemas/core.yaml#

title: MStar/SigmaStar ARMv7 PM pinctrl

maintainers:
  - Daniel Palmer <daniel@thingy.co.jp>

description: |
  The Mstar/SigmaStar ARMv7 SoCs have a special pin controller
  for the pins that belong to the always on PM domain.
  As the "pmsleep" registers are accessed via it's syscon
  instances of this must be a child node of the pmsleep syscon.

properties:
  compatible:
    enum:
      - mstar,msc313-pm-pinctrl
      - mstar,msc313e-pm-pinctrl
      - mstar,ssc8336-pm-pinctrl
      - mstar,ssc8336n-pm-pinctrl
      - sstar,ssd20xd-pm-pinctrl
      - sstar,ssd210-pm-pinctrl
      - sstar,ssd212-pm-pinctrl

required:
  - compatible

patternProperties:
  '-pins$':
    type: object
    $ref: "pinmux-node.yaml"

    properties:
      function:
        description:
          Function to mux.
        $ref: "/schemas/types.yaml#/definitions/string"
        enum: [pm_uart, pm_spi, pm_irin, pm_led]

      groups:
        description:
          Name of the pin group to use for the functions.
        $ref: "/schemas/types.yaml#/definitions/string"
        enum: [pm_uart, pm_spi, pm_irin, pm_led_mode1]

additionalProperties: false

examples:
  - |
    syscon@1c00 {
        compatible = "mstar,msc313-pmsleep", "syscon", "simple-mfd";
        reg = <0x1c00 0x100>;

        pinctrl {
            compatible = "mstar,msc313-pm-pinctrl";
            pm_uart {
                function = "pm_uart";
                groups = "pm_uart";
            };
            pm_spi {
                function = "pm_spi";
                groups = "pm_spi";
            };
            pm_irin {
                function = "pm_irin";
                groups = "pm_irin";
            };
        };
    };
```

## Documentation/devicetree/bindings/pwm/mstar,msc313e-pwm.yaml
```yaml
# SPDX-License-Identifier: (GPL-2.0-only OR BSD-2-Clause)
%YAML 1.2
---
$id: http://devicetree.org/schemas/pwm/mstar,msc313e-pwm.yaml#
$schema: http://devicetree.org/meta-schemas/core.yaml#

title: Mstar MSC313e PWM controller

maintainers:
  - Daniel Palmer <daniel@0x0f.com>
  - Romain Perier <romain.perier@gmail.com>

allOf:
  - $ref: "pwm.yaml#"

properties:
  compatible:
      enum:
        - mstar,msc313e-pwm
        - mstar,ssd20xd-pwm

  reg:
    maxItems: 1

  clocks:
    maxItems: 1

  "#pwm-cells":
    const: 2

required:
  - compatible
  - reg
  - clocks

additionalProperties: false

examples:
  - |
    pwm: pwm@3400 {
      compatible = "mstar,msc313e-pwm";
      reg = <0x3400 0x400>;
      #pwm-cells = <2>;
      clocks = <&xtal_div2>;
    };
```

## Documentation/devicetree/bindings/pwm/mstar,pwm-msc313e.yaml
```yaml
# SPDX-License-Identifier: GPL-2.0
%YAML 1.2
---
$id: http://devicetree.org/schemas/pwm/mstar,pwm-msc313e.yaml#
$schema: http://devicetree.org/meta-schemas/core.yaml#

title: MStar/SigmaStar PWM controller

maintainers:
  - Daniel Palmer <daniel@thingy.jp>

properties:
  compatible:
    items:
      - enum:
          - mstar,pwm-msc313e # MSC313E, 8 channels 
          - mstar,pwm-ssd20xd # SSD201/SSD202D, 4 channels

  reg:
    maxItems: 1

  '#pwm-cells':
    # should be 2. See pwm.yaml in this directory for a description of
    # the cells format.
    const: 2

  clocks:
    # clock phandle and specifier pair.
    maxItems: 1

required:
  - compatible
  - reg
  - '#pwm-cells'
  - clocks

additionalProperties: false

examples:
  - |
    pwm: pwm@3400 {
        compatible = "mstar,msc313e-pwm";
        reg = <0x3400 0x400>;
        #pwm-cells = <2>;
        clocks = <&xtal12>;
    };
```

## Documentation/devicetree/bindings/rng/mstar-msc313-rng.yaml
```yaml
# SPDX-License-Identifier: (GPL-2.0 OR BSD-2-Clause)
%YAML 1.2
---
$id: http://devicetree.org/schemas/rng/mstar-msc313-rng.yaml#
$schema: http://devicetree.org/meta-schemas/core.yaml#

title: MStar MSC313 HWRNG

maintainers:
  - Daniel Palmer <daniel@thingy.jp>

description: |+
  MStar MSC313 and later MStar and SigmaStar HWRNG 

properties:
  compatible:
    const: mstar,msc313-rng

  reg:
    maxItems: 1

  clocks:
    maxItems: 1

required:
  - compatible
  - reg

additionalProperties: false

examples:
  - |
    #include <dt-bindings/clock/mstar-msc313-clkgen.h>
    rng@224400 {
        compatible = "mstar,msc313-rng";
        reg = <0x224400 0x10>;
        clocks = <&clkgen MSC313_CLKGEN_DEGLITCHES MSC313_CLKGEN_MIU 0>;
    };

...
```

## Documentation/devicetree/bindings/spi/mstar,msc313-mspi.yaml
```yaml
# SPDX-License-Identifier: (GPL-2.0-only OR BSD-2-Clause)
%YAML 1.2
---
$id: http://devicetree.org/schemas/spi/mstar,msc313-mspi.yaml#
$schema: http://devicetree.org/meta-schemas/core.yaml#

title: MStar/SigmaStar SPI Controller bindings

description: |
  All MStar/SigmaStar ARMv7 based SoCs contain one of more of
  these SPI controllers. The newer versions support using MOVEDMA
  to do transfers with DMA.

maintainers:
  - Daniel Palmer <daniel@thingy.jp>

allOf:
  - $ref: "spi-controller.yaml#"

properties:
  compatible:
    enum:
      - mstar,msc313-spi
      - sstar,ssd20xd-spi

  reg:
    maxItems: 1

  clocks:
    maxItems: 1

  interrupts:
    maxItems: 1

  resets:
    maxItems: 1

required:
  - compatible
  - reg
  - clocks
  - interrupts

unevaluatedProperties: false

...
```

## arch/arm/configs/breadbee_defconfig
```kconfig
CONFIG_ARCH_MULTI_V7=y
CONFIG_ARCH_MULTI_V6_V7=y
CONFIG_ARCH_MSTAR=y
CONFIG_MACH_MSC313E=y
CONFIG_ARM_THUMB=y
CONFIG_USE_OF=y
CONFIG_VFP=y
CONFIG_VFPv3=y
CONFIG_NEON=y
CONFIG_KERNEL_MODE_NEON=y
```
